## drivers/input/misc/chipone_fps/Kconfig
```kconfig
config INPUT_CHIPONE_FPS
	tristate "Chipone fingerprint sensor MMI"
	default n
	help
	 Say Y here if you wish to include support for MMI Chipone finger print sensor.
	 If unsure, say N.
```

## drivers/input/misc/focaltech_fps/Kconfig
```kconfig
config INPUT_FOCALTECH_FPS
	tristate "Focaltech fingerprint sensor MMI"
	default n
	help
	 Say Y here if you wish to include support for MMI Focaltech finger print sensor.
	 If unsure, say N.
```
